## Kconfig
```kconfig
menu "W5100 Ethernet (SPI)"

    choice W5100_RX_TASK_CORE
        prompt "Core of the RX polling task"
        default W5100_RX_TASK_CORE_0
        help
            The W5100 has no usable link/frame interrupt in this driver, so a task polls the chip for
            received frames. Pin it to the core that runs lwIP (core 0 by default) so time-critical code
            on the other core is never preempted by network traffic.

        config W5100_RX_TASK_CORE_0
            bool "Core 0 (PRO CPU)"
        config W5100_RX_TASK_CORE_1
            bool "Core 1 (APP CPU)"
            depends on !FREERTOS_UNICORE
        config W5100_RX_TASK_NO_AFFINITY
            bool "No affinity"
    endchoice

    config W5100_RX_TASK_PRIORITY
        int "RX polling task priority"
        range 1 24
        default 15
        help
            FreeRTOS priority of the RX polling task. The IDF Ethernet drivers use 15.

    config W5100_RX_TASK_STACK_SIZE
        int "RX polling task stack size"
        range 2048 16384
        default 4096

    config W5100_RX_POLL_TICKS
        int "RX poll interval (ticks)"
        range 1 100
        default 1
        help
            How long the RX task sleeps between polls when the chip has no frame waiting. Each poll costs
            a few SPI transactions; 1 tick gives the lowest latency. Must be at least 1, otherwise the task
            never blocks and starves lower priority tasks on its core.

    config W5100_CMD_TIMEOUT_MS
        int "Chip command timeout (ms)"
        range 10 5000
        default 100
        help
            Upper bound for every busy wait on the chip (reset, socket commands, TX completion). On timeout
            the operation fails with an error instead of hanging the calling task.

    menu "Debug"
        config W5100_DEBUG_TX
            bool "Dump transmitted frames"
            help
                Hex dump of every frame sent to the chip, at debug log level.

        config W5100_DEBUG_RX
            bool "Dump received frames"
            help
                Hex dump of every frame read from the chip, at debug log level.
    endmenu

endmenu
```

## examples/ethernet_basic/main/Kconfig.projbuild
```kconfig
menu "Example configuration"

    config EXAMPLE_W5100_SCLK_GPIO
        int "SCLK GPIO (shield ICSP pin 3)"
        default 18

    config EXAMPLE_W5100_MISO_GPIO
        int "MISO GPIO (shield ICSP pin 1)"
        default 19

    config EXAMPLE_W5100_MOSI_GPIO
        int "MOSI GPIO (shield ICSP pin 4)"
        default 23

    config EXAMPLE_W5100_CS_GPIO
        int "CS GPIO (shield D10)"
        default 17

    config EXAMPLE_W5100_RST_GPIO
        int "W5100 /RESET GPIO, -1 if not connected"
        range -1 33
        default -1
        help
            Keep -1 on Arduino Ethernet shields: their RESET pin is not the W5100 /RESET but the manual
            reset input of a CAT811 supervisor powered from 5 V (internal pull-up to 5 V), and the
            supervisor already resets the W5100 at power-up. The driver also resets the chip by software.
            Use a GPIO only on boards that expose the W5100 /RESET at 3.3 V (see docs/wiring.md).

    config EXAMPLE_W5100_SPI_CLOCK_KHZ
        int "SPI clock (kHz)"
        range 100 14000
        default 4000
        help
            The W5100 accepts up to 14 MHz. Lower it if the chip is not detected with long jumper wires.

    config EXAMPLE_PING_COUNT
        int "Pings sent to the gateway"
        default 5

endmenu
```

## examples/ethernet_basic/sdkconfig.defaults
```kconfig
CONFIG_IDF_TARGET="esp32"
CONFIG_ESP_MAIN_TASK_STACK_SIZE=8192
CONFIG_W5100_RX_TASK_CORE_0=y
CONFIG_LWIP_TCPIP_TASK_AFFINITY_CPU0=y
```
